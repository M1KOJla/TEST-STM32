#include "uart_proc.h"

//-----------------------------------------------------------------------------
//
//-----------------------------------------------------------------------------

char message_blink_LED_ON [] = "LED BLINKING ON \n";				
char message_blink_LED_OFF [] = "LED BLINKING OFF \n";				

//-----------------------------------------------------------------------------
//
//-----------------------------------------------------------------------------

void uart_send_str (char* str)							//функция передачи строки по UART
{	
    while (*str)								// Цикл по символам строки (до \0)
    {
      while (!(USART1 -> SR & USART_SR_TC)) {}				        //ждем пока завершиться передача по UART
      USART1 -> DR = *str;						        //Записываем символ в регистр данных
      str++;								        //увеличиваем указатель
    }	
}

//-----------------------------------------------------------------------------
//
//-----------------------------------------------------------------------------

void uart_repit (void)								//функция UART репитера. Повторяет принятые данные
{	
    if (USART1->SR & USART_SR_RXNE)						//принятые данные готовы к чтению
    {      
      char temp = USART1->DR;							//чтение принятых данных в temp
      USART1->DR = temp;							//запись данных из temp в регистр DR для передачи по UART
      while (!(USART1->SR & USART_SR_TC)) {}					//ждем пока завершиться передача				
    }		
}

//-----------------------------------------------------------------------------
//
//-----------------------------------------------------------------------------

void uart_send (uint8_t button_state)
{
   static uint8_t previous_button_state = 0;
   
   if (previous_button_state != button_state)
   {
      switch (button_state)
      {
        case 0:
              uart_send_str (message_blink_LED_OFF);			
              break;
        case 1:
              uart_send_str (message_blink_LED_ON);			
              break;	
      }
   }
  
    previous_button_state = button_state;
}

//-----------------------------------------------------------------------------
//
//-----------------------------------------------------------------------------
